## telemetry/Kconfig
```kconfig
#
# For a description of the syntax of this configuration file,
# see the file kconfig-language.txt in the NuttX tools repository.
#

config PYGMY_TELEM_TELEMETRY
	bool "Pygmy telemetry"
	default n
	---help---
		Primary telemetry application for logging and radio transmission of telemetry.

if PYGMY_TELEM_TELEMETRY

comment "Program options"

config PYGMY_TELEM_PRIORITY
	int "Application priority"
	default 100

config PYGMY_TELEM_STACKSIZE
	int "Application stack size"
	default 2048

comment "Device path options"

config PYGMY_TELEM_RADIOPATH
	string "Radio path"
	default "/dev/rn2903"
	---help---
		The path to the character device to use as the transmitter.

config PYGMY_TELEM_PWRFS
	string "Power fail-safe file system path"
	default "/pwrfs"
	---help---
		The path to the power fail safe file system

config PYGMY_TELEM_USRFS
	string "User file system path"
	default "/ejectfs"
	---help---
		The path to the user file system (for log extraction on host computer)

config PYGMY_TELEM_CONFIGFILE
	string "Configuration file path"
	default "/eeprom"
	---help---
		The path to the user configuration file.

config PYGMY_TELEM_USB
	string "USB device file path"
	depends on USBDEV
	default "/dev/ttyACM0"
	---help---
		The path to the USB output device.

config PYGMY_TELEM_BAT_ADC
	string "Battery ADC file path"
	depends on ADC
	default "/dev/adc0"
	---help---
		The path to the ADC device that reads battery voltage.

comment "Packet options"

config PYGMY_CALLSIGN_LEN
	int "Length of call sign"
	default 6
	---help---
		The length of the user callsign prepended to each transmitted packet.
		Default of 6 allows standard Canadian HAM call sign.

config PYGMY_PACKET_MAXLEN
	int "Maximum packet length"
	default 255
	---help---
		Maximum allowed packet length in bytes. Packet length in transmission 
		is still limited by the radio setting, this only affects construction.

config PYGMY_NLOGSAVE
	int "Log save interval"
	default 20
	---help---
		It takes some time to save the logs to littlefs when flushed, so flush
		calls should be limited. However, if power is lost between flushes, all
		unflushed logs are lost. The user can decide after how many logs to
		flush.

comment "Sampling options"

config PYGMY_BARO_FREQ
	int "Barometer sample frequency (Hz)"
	depends on SENSORS_MS56XX
	range 0 100
	default 25
	---help---
		The sampling frequency of the barometer in Hz.

config PYGMY_ACCEL_FREQ
	int "Accelerometer sample frequency (Hz)"
	depends on SENSORS_LSM6DSO32
	default 50
	range 0 6666
	---help---
		The sampling frequency of the accelerometer in Hz.

config PYGMY_GYRO_FREQ
	int "Gyroscope sample frequency (Hz)"
	depends on SENSORS_LSM6DSO32
	default 50
	range 0 6666
	---help---
		The sampling frequency of the gyroscope in Hz.

config PYGMY_MAG_FREQ
	int "Magnetometer sample frequency (Hz)"
	depends on SENSORS_LIS2MDL
	default 50
	range 0 100
	---help---
		The sampling frequency of the magnetometer in Hz.

config PYGMY_GPS_FREQ
	int "GPS sample frequency (Hz)"
	depends on SENSORS_L86_XXX
	default 10
	range 0 10
	---help---
		The sampling frequency of the GPS device in Hz.

comment "Syslog options"

config PYGMY_SYSLOG_ERR
	bool "Error logs enabled"
	depends on SYSLOG
	default n
	---help---
		Enables error syslog outputs on Pygmy.

config PYGMY_SYSLOG_WARN
	bool "Warning logs enabled"
	depends on SYSLOG
	default n
	---help---
		Enables warning syslog outputs on Pygmy.

config PYGMY_SYSLOG_INFO
	bool "Info logs enabled"
	depends on SYSLOG
	default n
	---help---
		Enables info syslog outputs on Pygmy.

config PYGMY_SYSLOG_DEBUG
	bool "Debug logs enabled"
	depends on SYSLOG
	default n
	---help---
		Enables debug syslog outputs on Pygmy.

endif
```
